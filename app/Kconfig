## app/Kconfig
```kconfig
menuconfig LED_SUBSYSTEM
    bool "LED Subsystem"
    default y

if LED_SUBSYSTEM

choice
    prompt "LED blink sleep time"
    default LED_BLINK_SLEEP_1000MS

config LED_BLINK_SLEEP_250MS
    bool "250ms (fast)"

config LED_BLINK_SLEEP_500MS
    bool "500ms (semi-fast)"

config LED_BLINK_SLEEP_1000MS
    bool "1s (medium)"

config LED_BLINK_SLEEP_2000MS
    bool "2s (slow)"

endchoice

config LED_BLINK_SLEEP_TIME_MS
    int
    default 250  if LED_BLINK_SLEEP_250MS
    default 500  if LED_BLINK_SLEEP_500MS
    default 1000 if LED_BLINK_SLEEP_1000MS
    default 2000 if LED_BLINK_SLEEP_2000MS
    default 0

menuconfig ADVANCED_LED_SETTINGS
    bool "Advanced LED settings"
    default n

if ADVANCED_LED_SETTINGS

config LED_BRIGHTNESS
    int "LED brightness (0-100)"
    range 0 100
    default 100

config LED_FADE_DURATION
    int "LED fade duration (ms)"
    range 0 5000
    default 500

menu "Expert settings"
    # Hide the expert settings under some odd settings from the advanced menu
    # Something like only a developer would know, a bit silly because it uses magic numbers as condition...
    visible if LED_BRIGHTNESS = 99 && LED_FADE_DURATION = 499 

config LED_DEBUGGING
    bool "Enable LED debugging"
    default n

config CUSTOM_BLINK_PATTERN
    bool "Custom blink pattern"
    default n

endmenu # Expert_settings

endif # ADVANCED_LED_SETTINGS

endif # LED_SUBSYSTEM

source "Kconfig.zephyr"
```
